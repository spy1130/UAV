/*==========================================================================
 * 描述    ：遥控器数据处理：一键停机，功能选择等
 * 更新时间：2023年3月23日
 * 作者		 ：	LHB
===========================================================================*/

#include "User_RC.h"
#include "Drv_RcIn.h"
#include "Timer.h"
#include "hw_ints.h"
#include "uart.h"
#include "ANO_LX.h"
#include "ANO_DT_LX.h"
#include "LX_FC_Fun.h"
#include "LX_FC_State.h"
#include "ANO_DT_LX.h"
#include "User_Ctrl.h"

/**************************************************************************
函数功能：用户遥控器按键检测
入口参数：
返回  值：
作    者：LHB
**************************************************************************/
void User_RC_Check(void)
{
	RC_LOCK_Check();
	RC_LAND_Check();
}
/**************************************************************************
函数功能：飞控一键上锁
入口参数：
返回  值：
作    者：LHB
**************************************************************************/
void RC_LOCK_Check(void)//ANO_LX.c调用
{
	/*判断遥控器右上角按钮是否被打下*/
	if(rc_in.rc_ch.st_data.ch_[ch_7_aux3]>1400)
	{
		LocCtrlEnable=0;//速度控制失能
		AngCtrlEnable=0;
		AttCtrlEnable=0;
		FC_Lock();/*上锁*/
	}
}
/**************************************************************************
函数功能：飞机一键降落
入口参数：
返回  值：
作    者：LHB
**************************************************************************/
void RC_LAND_Check(void)
{
	static uint8_t i=0;/*是否执行标志位*/
	/*判断遥控器左上角按钮是否被打下*/
	if(rc_in.rc_ch.st_data.ch_[ch_8_aux4]>1400)
	{
		if(i==0)
		{	
			LocCtrlEnable=0;//速度控制失能
			AngCtrlEnable=0;
			AttCtrlEnable=0;
			i=OneKey_Land();/*一键降落，成功执行一次后不再执行*/
		}
	}
	else
		i=0;/*标志位复位*/
}



